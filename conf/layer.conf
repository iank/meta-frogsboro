## conf/layer.conf
```bitbake
# We have a conf and classes directory, add to BBPATH
BBPATH .= ":${LAYERDIR}"

# We have recipes-* directories, add to BBFILES
BBFILES += "${LAYERDIR}/recipes-*/*/*.bb \
            ${LAYERDIR}/recipes-*/*/*.bbappend"

BBFILE_COLLECTIONS += "frogsboro"
BBFILE_PATTERN_frogsboro = "^${LAYERDIR}/"
BBFILE_PRIORITY_frogsboro = "11"

LAYERDEPENDS_frogsboro = "atmel"
LAYERSERIES_COMPAT_frogsboro = "dunfell"
```

## conf/local.conf.sample
```bitbake
MACHINE ??= "sam9x60ek-sd-frogsboro"
DISTRO ?= "poky-atmel"
PACKAGE_CLASSES ?= "package_ipk"
EXTRA_IMAGE_FEATURES ?= "read-only-rootfs empty-root-password"
USER_CLASSES ?= "buildstats image-mklibs image-prelink"
PATCHRESOLVE = "noop"

BB_DISKMON_DIRS ??= "\
    STOPTASKS,${TMPDIR},1G,100K \
    STOPTASKS,${DL_DIR},1G,100K \
    STOPTASKS,${SSTATE_DIR},1G,100K \
    STOPTASKS,/tmp,100M,100K \
    ABORT,${TMPDIR},100M,1K \
    ABORT,${DL_DIR},100M,1K \
    ABORT,${SSTATE_DIR},100M,1K \
    ABORT,/tmp,10M,1K"

CONF_VERSION = "1"
LICENSE_FLAGS_WHITELIST += "commercial"
SYSVINIT_ENABLED_GETTYS = ""
INHERIT += "rm_work"

ENABLE_BINARY_LOCALE_GENERATION = "1"

GLIBC_SPLIT_LC_PACKAGES = "1"

GLIBC_GENERATE_LOCALES += "en_GB.UTF-8 en_US.UTF-8 fr_FR.UTF-8 hi_IN.UTF-8 de_DE.UTF-8 zh_CN.UTF-8 es_ES.UTF-8"
IMAGE_LINGUAS += "en-gb en-us fr-fr hi-in de-de zh-cn es-es"
```

## conf/machine/sam9x60ek-sd-frogsboro.conf
```bitbake
#@TYPE: Machine
#@Name: FROGSBORO
#@DESCRIPTION: Machine configuration for FROGSBORO

require conf/machine/include/sam9x60.inc

MACHINE_FEATURES = "apm alsa ext2 ext3 usbhost usbgadget screen touchscreen"
KERNEL_DEVICETREE = " at91-sam9x60ek.dtb "

IMAGE_FSTYPES += " tar.gz wic"

do_image_wic[depends] += "u-boot-at91:do_deploy"
WKS_FILE = "sdimage-boot-data.wks"
IMAGE_BOOT_FILES = "BOOT.BIN u-boot.bin uboot.env sam9x60ek.itb"

UBOOT_MACHINE ?= "sam9x60ek_mmc_defconfig"
UBOOT_ENTRYPOINT = "0x20008000"
UBOOT_LOADADDRESS = "0x20008000"
UBOOT_ENV_SIZE = "0x4000"

AT91BOOTSTRAP_MACHINE ?= "sam9x60ek"
AT91BOOTSTRAP_CONFIG_sam9x60ek-sd-frogsboro ?= "${AT91BOOTSTRAP_MACHINE}sd_uboot"
AT91BOOTSTRAP_LOAD_sam9x60ek-sd-frogsboro ?= "sdboot-uboot"

# Needed for wic
EXTRA_IMAGEDEPENDS += "dosfstools-native mtools-native"

# Needed for FIT
MACHINE_ESSENTIAL_EXTRA_RDEPENDS = " dt-overlay-at91"
```
